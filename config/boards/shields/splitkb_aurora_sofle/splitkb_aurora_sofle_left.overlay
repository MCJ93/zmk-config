/ {
    wired_split {
        compatible = "zmk,wired-split";
        device = <&pro_micro_serial>;
ewf
w
ef
wfwefwe
    };
};

&pro_micro_serial {
    status = "okay";
    current-speed = <115200>;
};
