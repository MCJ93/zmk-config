## boards/shields/splitkb_aurora_sofle_left/Kconfig.shield
```kconfig
# SPDX-License-Identifier: MIT
config SHIELD_SPLITKB_AURORA_SOFLE_LEFT
    bool "splitkb_aurora_sofle_left"
```

## boards/shields/splitkb_aurora_sofle_right/Kconfig.shield
```kconfig
# SPDX-License-Identifier: MIT
config SHIELD_SPLITKB_AURORA_SOFLE_RIGHT
    bool "splitkb_aurora_sofle_right"
```
